## boards/shields/boards/Kconfig.defconfig
```kconfig
if SHIELD_KALY42_L

config ZMK_KEYBOARD_NAME
    default "Kaly42"
    
config ZMK_SPLIT_ROLE_CENTRAL
    default y

endif

if SHIELD_KALY42_L || SHIELD_KALY42_R

config ZMK_SPLIT
    default y

endif
```

## boards/shields/boards/Kconfig.shield
```kconfig
config SHIELD_KALY42_L
    def_bool $(shields_list_contains,kaly_l)

config SHIELD_KALY42_R
    def_bool $(shields_list_contains,kaly_r)
```
